## meta-evb/meta-evb-nuvoton/conf/layer.conf
```bitbake
# We have a conf and classes directory, add to BBPATH
BBPATH .= ":${LAYERDIR}"

# We have recipes-* directories, add to BBFILES
BBFILES += "${LAYERDIR}/recipes-*/*/*.bb \
            ${LAYERDIR}/recipes-*/*/*.bbappend"

BBFILE_COLLECTIONS += "evb-nuvoton"
BBFILE_PATTERN_evb-nuvoton = ""
LAYERSERIES_COMPAT_evb-nuvoton = "thud"
```

## meta-evb/meta-evb-nuvoton/meta-buv-runbmc/conf/distro/buv-dev.conf
```bitbake
require conf/distro/openbmc-phosphor.conf

DISTRO = "buv-dev"
DISTRO_FEATURES += "buv-dev"
```

## meta-evb/meta-evb-nuvoton/meta-buv-runbmc/conf/distro/buv-entity.conf
```bitbake
require conf/distro/openbmc-phosphor.conf

VIRTUAL-RUNTIME_obmc-inventory-manager = "entity-manager"
VIRTUAL-RUNTIME_obmc-sensors-hwmon = "dbus-sensors"
VIRTUAL-RUNTIME_phosphor-ipmi-providers = "phosphor-ipmi-fru"

PREFERRED_PROVIDER_virtual/obmc-inventory-data = "entity-manager"

DISTRO = "buv-entity"
DISTRO_FEATURES += "buv-entity"

MACHINE_FEATURES += "ext2"
```

## meta-evb/meta-evb-nuvoton/meta-buv-runbmc/conf/distro/buv-runbmc-emmc.conf
```bitbake
require conf/distro/openbmc-phosphor.conf
require conf/distro/include/phosphor-mmc.inc

DISTRO = "buv-runbmc-emmc"
BAD_RECOMMENDATIONS:remove = "e2fsprogs-e2fsck"
```

## meta-evb/meta-evb-nuvoton/meta-buv-runbmc/conf/machine/buv-runbmc.conf
```bitbake
require conf/machine/include/npcm7xx.inc
require conf/machine/include/obmc-bsp-common.inc

KMACHINE = "nuvoton"
KERNEL_DEVICETREE = "${KMACHINE}-npcm750-buv-runbmc.dtb"

FLASH_SIZE = "65536"
# avoid image_types_phosphor.bbclass override
FLASH_KERNEL_OFFSET:flash-65536 = "2048"
FLASH_ROFS_OFFSET:flash-65536 = "8192"
FLASH_RWFS_OFFSET:flash-65536 = "62464"

# U-Boot 2021.04 (2021.04+npcm-v2021.04+)
#PREFERRED_VERSION_u-boot-nuvoton ??= "2021.04+npcm-v2021.04+"
#PREFERRED_VERSION_u-boot-fw-utils-nuvoton ??= "2021.04+npcm-v2021.04+"

UBOOT_MACHINE = "PolegRunBMC_defconfig"
UBOOT_DEVICETREE = "nuvoton-npcm750-buv"
IGPS_MACHINE = "RunBMC"

IMAGE_FSTYPES += " cpio.${INITRAMFS_CTYPE}.u-boot"
IMAGE_FSTYPES += "${@bb.utils.contains('DISTRO_FEATURES', \
        'phosphor-mmc', \
        'wic.gz mmc-ext4-tar', \
        '', d)}"
KERNEL_ALT_IMAGETYPE = "vmlinux"

MACHINE_FEATURES += "\
        obmc-phosphor-fan-mgmt \
        obmc-host-ipmi \
        obmc-phosphor-chassis-mgmt \
        "
VIRTUAL-RUNTIME_obmc-host-state-manager = "x86-power-control"
VIRTUAL-RUNTIME_obmc-chassis-state-manager = "x86-power-control"
VIRTUAL-RUNTIME_obmc-discover-system-state = "x86-power-control"

#KCS_DEVICE = "ipmi-kcs1"
PREFERRED_PROVIDER_virtual/obmc-host-ipmi-hw = "phosphor-ipmi-kcs"
#PREFERRED_PROVIDER_virtual/obmc-host-ipmi-hw = "phosphor-ipmi-ssif"
PREFERRED_PROVIDER_virtual/obmc-fan-mgmt = "packagegroup-buv-runbmc-apps"
PREFERRED_PROVIDER_virtual/obmc-system-mgmt = "packagegroup-buv-runbmc-apps"
PREFERRED_PROVIDER_virtual/obmc-chassis-mgmt = "packagegroup-buv-runbmc-apps"

DISTRO_FEATURES += "ext2"
MACHINE_FEATURES += "ext2"

DISTRO_FEATURES:remove = "avahi"
DISTRO_FEATURES:remove = "slp"

IMAGE_FEATURES:remove = "obmc-fan-control"
MACHINEOVERRIDES .= ":buv-runbmc"
```

## meta-evb/meta-evb-nuvoton/meta-evb-npcm750/conf/distro/poleg-evb-emmc.conf
```bitbake
require conf/distro/openbmc-phosphor.conf
require conf/distro/include/phosphor-mmc.inc

DISTRO = "poleg-evb-emmc"
```

## meta-evb/meta-evb-nuvoton/meta-evb-npcm750/conf/machine/evb-npcm750.conf
```bitbake
KMACHINE = "nuvoton"
KERNEL_DEVICETREE = "${KMACHINE}-npcm750-evb.dtb"
UBOOT_MACHINE = "PolegRunBMC_defconfig"
UBOOT_DEVICETREE = "nuvoton-npcm750-evb"
IGPS_MACHINE = "EB"

require conf/machine/include/npcm7xx.inc
require conf/machine/include/obmc-bsp-common.inc

FLASH_SIZE = "32768"

MACHINE_FEATURES += "\
        obmc-phosphor-fan-mgmt \
        obmc-phosphor-chassis-mgmt \
        obmc-phosphor-flash-mgmt \
        obmc-host-ipmi \
        obmc-host-state-mgmt \
        obmc-chassis-state-mgmt \
        obmc-bmc-state-mgmt \
        "

MACHINE_FEATURES:append = " ext2"

VIRTUAL-RUNTIME_obmc-host-state-manager = "x86-power-control"
VIRTUAL-RUNTIME_obmc-chassis-state-manager = "x86-power-control"

PREFERRED_VERSION_linux-nuvoton ?= "5.15%"
PREFERRED_PROVIDER_virtual/obmc-chassis-mgmt = "packagegroup-evb-npcm750-apps"
PREFERRED_PROVIDER_virtual/obmc-fan-mgmt = "packagegroup-evb-npcm750-apps"
PREFERRED_PROVIDER_virtual/obmc-flash-mgmt = "packagegroup-evb-npcm750-apps"
PREFERRED_PROVIDER_virtual/obmc-system-mgmt = "packagegroup-evb-npcm750-apps"
PREFERRED_PROVIDER_virtual/phosphor-led-manager-config-native = "evb-npcm750-led-manager-config-native"
PREFERRED_PROVIDER_virtual/obmc-host-ipmi-hw = "phosphor-ipmi-kcs"
```

## meta-evb/meta-evb-nuvoton/meta-evb-npcm845/conf/distro/arbel-evb-emmc-entity.conf
```bitbake
require conf/distro/openbmc-phosphor.conf
require conf/distro/include/phosphor-mmc.inc

VIRTUAL-RUNTIME_obmc-inventory-manager = "entity-manager"
VIRTUAL-RUNTIME_obmc-sensors-hwmon = "dbus-sensors"
PREFERRED_PROVIDER_virtual/obmc-inventory-data = "entity-manager"

MACHINE_EXTRA_RRECOMMENDS = "kernel-modules"

DISTRO = "arbel-evb-emmc"
DISTRO:append = "-entity"
DISTRO_NAME = "Nuvoton OpenBMC (Entity Manager)"
DISTRO_FEATURES:append = " ext2"
DISTRO_FEATURES:append = " entity-manager"
DISTRO_FEATURES:append = " ipmi-fru"

# Remove unneeded binaries from image
IMAGE_FEATURES:remove = "obmc-health-monitor"

# eMMC layout
# max uboot image size in SPI partition is 768K
MMC_UBOOT_SIZE = "640"

WKS_FILE ?= "emmc-arbel-evb.wks.in"
WKS_FILE_DEPENDS ?= " \
    virtual/bootloader \
    virtual/kernel \
"
IMAGE_BOOT_FILES ?= "fitImage-${INITRAMFS_IMAGE}-${MACHINE}-${MACHINE};fitImage"
```

## meta-evb/meta-evb-nuvoton/meta-evb-npcm845/conf/distro/arbel-evb-emmc.conf
```bitbake
require conf/distro/openbmc-phosphor.conf
require conf/distro/include/phosphor-mmc.inc

DISTRO = "arbel-evb-emmc"
```

## meta-evb/meta-evb-nuvoton/meta-evb-npcm845/conf/distro/arbel-evb-entity.conf
```bitbake
require conf/distro/openbmc-phosphor.conf

VIRTUAL-RUNTIME_obmc-inventory-manager = "entity-manager"
VIRTUAL-RUNTIME_obmc-sensors-hwmon = "dbus-sensors"
PREFERRED_PROVIDER_virtual/obmc-inventory-data = "entity-manager"

DISTRO = "arbel-evb-entity"
DISTRO_NAME = "Nuvoton OpenBMC (Arbel-EVB-Entity Manager)"
DISTRO_FEATURES_append = " entity-manager"
DISTRO_FEATURES_append = " ipmi-fru"

# Remove unneeded binaries from image
IMAGE_FEATURES_remove = "obmc-health-monitor"
```

## meta-evb/meta-evb-nuvoton/meta-evb-npcm845/conf/machine/evb-npcm845.conf
```bitbake
KMACHINE = "nuvoton"
KERNEL_DEVICETREE = "nuvoton/${KMACHINE}-npcm845-evb.dtb"

UBOOT_MACHINE = "ArbelEVB_defconfig"

IGPS_MACHINE = "ArbelEVB"

SECURED_TIPFW = "True"

require conf/machine/include/npcm8xx.inc
require conf/machine/include/obmc-bsp-common.inc

FLASH_SIZE = "32768"
FLASH_UBOOT_OFFSET = "0"
FLASH_KERNEL_OFFSET = "2048"
FLASH_ROFS_OFFSET = "10240"
FLASH_RWFS_OFFSET = "31744"

# Don't generate MTD flash images until we're able to include the primary
# bootloader and the Linux MTD driver is ready.
IMAGE_FSTYPES += "cpio.${INITRAMFS_CTYPE}.u-boot"
IMAGE_FSTYPES += "${@bb.utils.contains('DISTRO_FEATURES', \
        'phosphor-mmc', \
        'wic.gz mmc-ext4-tar', \
        '', d)}"

OBMC_MACHINE_FEATURES += "\
        obmc-phosphor-fan-mgmt \
        obmc-phosphor-chassis-mgmt \
        obmc-phosphor-flash-mgmt \
        obmc-host-ipmi \
        obmc-host-state-mgmt \
        obmc-chassis-state-mgmt \
        obmc-bmc-state-mgmt \
        "

KCS_DEVICE = "ipmi-kcs1"

DISTRO_FEATURES += "ext2"
MACHINE_FEATURES += "ext2"

PREFERRED_PROVIDER_virtual/obmc-chassis-mgmt = "packagegroup-evb-npcm845-apps"
PREFERRED_PROVIDER_virtual/obmc-fan-mgmt = "packagegroup-evb-npcm845-apps"
PREFERRED_PROVIDER_virtual/obmc-flash-mgmt = "packagegroup-evb-npcm845-apps"
PREFERRED_PROVIDER_virtual/obmc-system-mgmt = "packagegroup-evb-npcm845-apps"
PREFERRED_PROVIDER_virtual/obmc-host-ipmi-hw = "phosphor-ipmi-kcs"
```

## meta-evb/meta-evb-nuvoton/meta-scm-npcm845/conf/distro/arbel-scm-emmc-entity.conf
```bitbake
require conf/distro/openbmc-phosphor.conf
require conf/distro/include/phosphor-mmc.inc

VIRTUAL-RUNTIME_obmc-inventory-manager = "entity-manager"
VIRTUAL-RUNTIME_obmc-sensors-hwmon = "dbus-sensors"
VIRTUAL-RUNTIME_phosphor-ipmi-providers = ""
PREFERRED_PROVIDER_virtual/obmc-inventory-data = "entity-manager"

DISTRO = "arbel-scm-emmc"
DISTRO:append = "-entity"
DISTRO_NAME = "Nuvoton OpenBMC (Entity Manager)"
DISTRO_FEATURES:append  = " entity-manager"
```

## meta-evb/meta-evb-nuvoton/meta-scm-npcm845/conf/machine/m1120-c2195.conf
```bitbake
require conf/machine/scm-npcm845.conf
KERNEL_DEVICETREE := "nuvoton/m1120-c219b.dtb"
UBOOT_DEVICETREE := "m1120"

# TODO: move c2195 common configuration into c2195.inc
MACHINEOVERRIDES .= ":scm-npcm845"
```

## meta-nuvoton-obmc/meta-scm-npcm845/conf/machine/m1120-c2195.conf
```bitbake
KMACHINE = "nuvoton"
KERNEL_DEVICETREE := "nuvoton/m1120-c219b.dtb"
PREFERRED_VERSION_linux-nuvoton ??= "6.1%"

UBOOT_DEVICETREE := "m1120"
UBOOT_MACHINE ?= "arbel_evb_defconfig"
PREFERRED_VERSION_u-boot-nuvoton ??= "2021.04+npcm-v2021.04+"
PREFERRED_VERSION_u-boot-fw-utils-nuvoton ??= "2021.04+npcm-v2021.04+"

IGPS_MACHINE = "EB"
DEVICE_GEN = "A1"

require conf/machine/include/npcm8xx.inc
require conf/machine/include/obmc-bsp-common.inc
require conf/machine/include/c2195.inc

FLASH_SIZE = "65536"
FLASH_UBOOT_OFFSET:flash-65536 = "0"
FLASH_UBOOT_ENV_OFFSET:flash-65536 = "7936"
FLASH_KERNEL_OFFSET:flash-65536 = "8192"
FLASH_ROFS_OFFSET:flash-65536 = "16384"
FLASH_RWFS_OFFSET:flash-65536 = "61440"

BB_ALIGN = "524288"

# Don't generate MTD flash images until we're able to include the primary
# bootloader and the Linux MTD driver is ready.
IMAGE_FSTYPES += "cpio.${INITRAMFS_CTYPE}.u-boot"
IMAGE_FSTYPES += "${@bb.utils.contains('DISTRO_FEATURES', \
        'phosphor-mmc', \
        'wic.gz mmc-ext4-tar', \
        '', d)}"

MACHINE_FEATURES += "\
        obmc-phosphor-fan-mgmt \
        obmc-phosphor-chassis-mgmt \
        obmc-phosphor-flash-mgmt \
        obmc-host-ipmi \
        obmc-host-state-mgmt \
        obmc-chassis-state-mgmt \
        obmc-bmc-state-mgmt \
        "

KCS_DEVICE = "ipmi-kcs1"

DISTRO_FEATURES:append = " ext2"
MACHINE_FEATURES:append = " ext2"

DISTRO_FEATURES:append = " tpm2"
MACHINE_FEATURES:append = " tpm2"

MACHINE_FEATURES:append = " optee-ftpm"

VIRTUAL-RUNTIME_obmc-host-state-manager ?= "x86-power-control"
VIRTUAL-RUNTIME_obmc-chassis-state-manager ?= "x86-power-control"

PREFERRED_PROVIDER_virtual/obmc-chassis-mgmt = "packagegroup-scm-npcm845-apps"
PREFERRED_PROVIDER_virtual/obmc-fan-mgmt = "packagegroup-scm-npcm845-apps"
PREFERRED_PROVIDER_virtual/obmc-flash-mgmt = "packagegroup-scm-npcm845-apps"
PREFERRED_PROVIDER_virtual/obmc-system-mgmt = "packagegroup-scm-npcm845-apps"
PREFERRED_PROVIDER_virtual/obmc-host-ipmi-hw = "phosphor-ipmi-kcs"
PREFERRED_PROVIDER_virtual/phosphor-led-manager-config-native = "scm-npcm845-led-manager-config-native"

# Remove unneeded binaries from image
IMAGE_FEATURES:remove = "obmc-fan-control"

MACHINE_EXTRA_RRECOMMENDS = "kernel-modules"
VOLATILE_LOG_DIR = "no"
```

## meta-nuvoton/conf/machine/evb-npcm750.conf
```bitbake
KMACHINE = "nuvoton"
KERNEL_DEVICETREE = "${KMACHINE}-npcm750-evb.dtb"

UBOOT_MACHINE = "PolegRunBMC_defconfig"
UBOOT_DEVICETREE = "nuvoton-npcm750-evb"
IGPS_MACHINE = "EB"

FLASH_SIZE = "32768"

require conf/machine/include/npcm7xx.inc
require conf/machine/include/obmc-bsp-common.inc

# Don't generate MTD flash images until we're able to include the primary
# bootloader and the Linux MTD driver is ready.
IMAGE_FSTYPES += "cpio.${INITRAMFS_CTYPE}.u-boot"
IMAGE_FSTYPES += "${@bb.utils.contains('DISTRO_FEATURES', \
        'phosphor-mmc', \
        'wic.gz mmc-ext4-tar', \
        '', d)}"

MACHINE_FEATURES += "\
        obmc-phosphor-fan-mgmt \
        obmc-phosphor-chassis-mgmt \
        obmc-phosphor-flash-mgmt \
        obmc-host-ipmi \
        obmc-host-state-mgmt \
        obmc-chassis-state-mgmt \
        obmc-bmc-state-mgmt \
        "

DISTRO_FEATURES:append = " ext2"
MACHINE_FEATURES:append = " ext2"

VIRTUAL-RUNTIME_obmc-host-state-manager ?= "x86-power-control"
VIRTUAL-RUNTIME_obmc-chassis-state-manager ?= "x86-power-control"

PREFERRED_PROVIDER_virtual/obmc-chassis-mgmt = "packagegroup-evb-npcm750-apps"
PREFERRED_PROVIDER_virtual/obmc-fan-mgmt = "packagegroup-evb-npcm750-apps"
PREFERRED_PROVIDER_virtual/obmc-flash-mgmt = "packagegroup-evb-npcm750-apps"
PREFERRED_PROVIDER_virtual/obmc-system-mgmt = "packagegroup-evb-npcm750-apps"
PREFERRED_PROVIDER_virtual/phosphor-led-manager-config-native = "evb-npcm750-led-manager-config-native"
PREFERRED_PROVIDER_virtual/obmc-host-ipmi-hw = "phosphor-ipmi-kcs"
```

## meta-nuvoton/conf/machine/include/nuvoton.inc
```bitbake
PREFERRED_PROVIDER_virtual/kernel ?= "linux-nuvoton"
PREFERRED_PROVIDER_virtual/bootloader ?= "u-boot-nuvoton"
PREFERRED_PROVIDER_u-boot ?= "u-boot-nuvoton"
PREFERRED_PROVIDER_u-boot-fw-utils ?= "u-boot-fw-utils-nuvoton"

MACHINEOVERRIDES .= ":nuvoton"

PREFERRED_VERSION_linux-nuvoton ??= "6.1%"

# fix build mmc distro error
IMAGE_FSTYPES:remove:df-phosphor-mmc = "mtd-static mtd-static-tar mtd-static-alltar"
```

## meta-nuvoton/conf/machine/include/runbmc-emmc.conf
```bitbake
require conf/distro/include/phosphor-mmc.inc

DISTRO_FEATURES += "ext2"
MACHINE_FEATURES += "ext2"

# eMMC layout
# max uboot image size in SPI partition is 768K
MMC_UBOOT_SIZE = "640"

WKS_FILE ?= "emmc-runbmc.wks.in"
WKS_FILE_DEPENDS ?= " \
    virtual/bootloader \
    virtual/kernel \
    "
IMAGE_BOOT_FILES ?= "fitImage-${INITRAMFS_IMAGE}-${MACHINE}-${MACHINE};fitImage"
```

## meta-quanta/meta-olympus-nuvoton/conf/machine/olympus-nuvoton.conf
```bitbake
require conf/machine/olympus-nuvoton-spi.conf
require conf/machine/include/runbmc-emmc.conf
```
