## meta-nuvoton-obmc/meta-evb-npcm750/conf/machine/evb-npcm750-stage.conf
```bitbake
require ../../../../meta-nuvoton/conf/machine/evb-npcm750.conf

SERIAL_CONSOLES = "115200;ttyS0"

FLASH_SIZE = "32768"
FLASH_KERNEL_OFFSET = "2048"
FLASH_ROFS_OFFSET = "7680"
FLASH_RWFS_OFFSET = "31744"

UBOOT_DEVICETREE = "nuvoton-npcm750-evb"
KERNEL_DEVICETREE = "${KMACHINE}-npcm750-evb.dtb"

IMAGE_FSTYPES += " cpio.${INITRAMFS_CTYPE}.u-boot"
IMAGE_FSTYPES += "${@bb.utils.contains('DISTRO_FEATURES', \
        'phosphor-mmc', \
        'wic.gz mmc-ext4-tar', \
        '', d)}"

MACHINE_FEATURES += "\
        obmc-host-ipmi \
        obmc-host-state-mgmt \
        obmc-chassis-state-mgmt \
        obmc-bmc-state-mgmt \
        "

PREFERRED_VERSION_linux-nuvoton ?= "6.1%"

DISTRO_FEATURES:append = " ext2"
MACHINE_FEATURES:append = " ext2"

VIRTUAL-RUNTIME_obmc-host-state-manager = "x86-power-control"
VIRTUAL-RUNTIME_obmc-chassis-state-manager = "x86-power-control"

PREFERRED_PROVIDER_virtual/phosphor-led-manager-config-native = "evb-npcm750-led-manager-config-native"
PREFERRED_PROVIDER_virtual/obmc-host-ipmi-hw = "phosphor-ipmi-kcs"
```

## meta-nuvoton-obmc/meta-evb-npcm845/conf/distro/arbel-evb-composite-eat.conf
```bitbake
require conf/distro/openbmc-phosphor.conf

# BMC-mediated Composite EAT attestation (also enables spdm)
require conf/distro/include/composite-eat.inc

VIRTUAL-RUNTIME_obmc-inventory-manager = "entity-manager"
VIRTUAL-RUNTIME_obmc-sensors-hwmon = "dbus-sensors"
VIRTUAL-RUNTIME_phosphor-ipmi-providers = ""
PREFERRED_PROVIDER_virtual/obmc-inventory-data = "entity-manager"

DISTRO = "arbel-evb-composite-eat"
DISTRO_NAME = "Nuvoton OpenBMC (Composite EAT)"
```
